## drivers/block/zram/Kconfig
```kconfig
config ZRAM
	tristate "Compressed RAM block device support"
	depends on BLOCK && SYSFS && CRYPTO
	depends on CRYPTO_842 || CRYPTO_LZ4 || CRYPTO_LZ4HC || CRYPTO_LZO || CRYPTO_ZSTD
	depends on ZPOOL && (Z3FOLD || ZSMALLOC)
	default n
	help
	  Creates virtual block devices called /dev/zramX (X = 0, 1, ...).
	  Pages written to these disks are compressed and stored in memory
	  itself. These disks allow very fast I/O and compression provides
	  good amounts of memory savings.

	  It has several use cases, for example: /tmp storage, use as swap
	  disks and maybe many more.

	  See Documentation/blockdev/zram.txt for more information.

config ZRAM_WRITEBACK
       bool "Write back incompressible page to backing device"
       depends on ZRAM
       default n
       help
	 With incompressible page, there is no memory saving to keep it
	 in memory. Instead, write it out to backing device.
	 For this feature, admin should set up backing device via
	 /sys/block/zramX/backing_dev.

	 See Documentation/blockdev/zram.txt for more information.

config ZRAM_MEMORY_TRACKING
	bool "Track zRam block status"
	depends on ZRAM && DEBUG_FS
	help
	  With this feature, admin can track the state of allocated blocks
	  of zRAM. Admin could see the information via
	  /sys/kernel/debug/zram/zramX/block_state.

	  See Documentation/blockdev/zram.txt for more information.

if ZRAM

choice
	prompt "Default zRAM backend"
	default DEFAULT_ZRAM_ZSMALLOC
	help
	  Select the memory allocator that will be used by default to
	  store compressed pages for all zRAM devices.

	config DEFAULT_ZRAM_Z3FOLD
		bool "z3fold" if Z3FOLD=y

	config DEFAULT_ZRAM_ZSMALLOC
		bool "zsmalloc" if ZSMALLOC=y
endchoice

config ZRAM_DEFAULT_BACKEND
	string
	default "z3fold" if DEFAULT_ZRAM_Z3FOLD
	default "zsmalloc" if DEFAULT_ZRAM_ZSMALLOC
	default "zsmalloc"

choice
	prompt "Default zRAM compressor"
	default DEFAULT_ZRAM_LZO
	help
	  Select the compressor that will be used by default to compress
	  pages for all zRAM devices.

	config DEFAULT_ZRAM_842
		bool "842" if CRYPTO_842=y

	config DEFAULT_ZRAM_LZ4
		bool "lz4" if CRYPTO_LZ4=y

	config DEFAULT_ZRAM_LZ4HC
		bool "lz4hc" if CRYPTO_LZ4HC=y

	config DEFAULT_ZRAM_LZO
		bool "lzo" if CRYPTO_LZO=y

	config DEFAULT_ZRAM_ZSTD
		bool "zstd" if CRYPTO_ZSTD=y
endchoice

config ZRAM_DEFAULT_COMPRESSOR
	string
	default "842" if DEFAULT_ZRAM_842
	default "lz4" if DEFAULT_ZRAM_LZ4
	default "lz4hc" if DEFAULT_ZRAM_LZ4HC
	default "lzo" if DEFAULT_ZRAM_LZO
	default "zstd" if DEFAULT_ZRAM_ZSTD
	default "lzo"

endif
```

## drivers/cpufreq/Kconfig
```kconfig
menu "CPU Frequency scaling"

config CPU_FREQ
	bool "CPU Frequency scaling"
	select SRCU
	select IRQ_WORK
	help
	  CPU Frequency scaling allows you to change the clock speed of 
	  CPUs on the fly. This is a nice method to save power, because 
	  the lower the CPU clock speed, the less power the CPU consumes.

	  Note that this driver doesn't automatically change the CPU
	  clock speed, you need to either enable a dynamic cpufreq governor
	  (see below) after boot, or use a userspace tool.

	  For details, take a look at <file:Documentation/cpu-freq>.

	  If in doubt, say N.

if CPU_FREQ

config CPU_FREQ_GOV_COMMON
	bool

config CPU_FREQ_BOOST_SW
	bool
	depends on THERMAL

config CPU_FREQ_STAT
	tristate "CPU frequency translation statistics"
	default y
	help
	  This driver exports CPU frequency statistics information through sysfs
	  file system.

	  To compile this driver as a module, choose M here: the
	  module will be called cpufreq_stats.

	  If in doubt, say N.

config CPU_FREQ_STAT_DETAILS
	bool "CPU frequency translation statistics details"
	depends on CPU_FREQ_STAT
	help
	  This will show detail CPU frequency translation table in sysfs file
	  system.

	  If in doubt, say N.

choice
	prompt "Default CPUFreq governor"
	default CPU_FREQ_DEFAULT_GOV_USERSPACE if ARM_SA1100_CPUFREQ || ARM_SA1110_CPUFREQ
	help
	  This option sets which CPUFreq governor shall be loaded at
	  startup. If in doubt, select 'performance'.

config CPU_FREQ_DEFAULT_GOV_PERFORMANCE
	bool "performance"
	select CPU_FREQ_GOV_PERFORMANCE
	help
	  Use the CPUFreq governor 'performance' as default. This sets
	  the frequency statically to the highest frequency supported by
	  the CPU.

config CPU_FREQ_DEFAULT_GOV_SCHEDUTIL
	bool "schedutil"
	depends on SMP
	select CPU_FREQ_GOV_SCHEDUTIL
	select CPU_FREQ_GOV_PERFORMANCE
	help
	  Use the 'schedutil' CPUFreq governor by default. If unsure,
	  have a look at the help section of that governor. The fallback
	  governor will be 'performance'.

config CPU_FREQ_DEFAULT_GOV_BLU_SCHEDUTIL
	bool "blu_schedutil"
	select CPU_FREQ_GOV_BLU_SCHEDUTIL
	select CPU_FREQ_GOV_PERFORMANCE
	help
	  Use the 'blu_schedutil' CPUFreq governor by default. If unsure,
	  have a look at the help section of that governor. The fallback
	  governor will be 'performance'.

	  If in doubt, say N.

config CPU_FREQ_DEFAULT_GOV_PWRUTILX
	bool "pwrutilx"
	depends on SMP
	select CPU_FREQ_GOV_PWRUTILX
	select CPU_FREQ_GOV_PERFORMANCE
	help
	  Use the 'pwrutilx' CPUFreq governor by default. If unsure,
	  have a look at the help section of that governor. The fallback
	  governor will be 'performance'.
	  
config CPU_FREQ_DEFAULT_GOV_SCHEDALUCARD
	bool "schedalucard"
	depends on SMP
	select CPU_FREQ_GOV_SCHEDALUCARD
	select CPU_FREQ_GOV_PERFORMANCE
	help
	  Use the 'schedalucard' CPUFreq governor by default. If unsure,
	  have a look at the help section of that governor. The fallback
	  governor will be 'performance'.

endchoice

config CPU_FREQ_GOV_PERFORMANCE
	tristate "'performance' governor"
	help
	  This cpufreq governor sets the frequency statically to the
	  highest available CPU frequency.

	  To compile this driver as a module, choose M here: the
	  module will be called cpufreq_performance.

	  If in doubt, say Y.

config CPU_FREQ_GOV_SCHEDUTIL
	bool "'schedutil' cpufreq policy governor"
	depends on CPU_FREQ && SMP
	select CPU_FREQ_GOV_ATTR_SET
	select IRQ_WORK
	help
	  This governor makes decisions based on the utilization data provided
	  by the scheduler.  It sets the CPU frequency to be proportional to
	  the utilization/capacity ratio coming from the scheduler.  If the
	  utilization is frequency-invariant, the new frequency is also
	  proportional to the maximum available frequency.  If that is not the
	  case, it is proportional to the current frequency of the CPU.  The
	  frequency tipping point is at utilization/capacity equal to 80% in
	  both cases.

	  If in doubt, say N.

config CPU_FREQ_GOV_BLU_SCHEDUTIL
	tristate "'blu_schedutil' cpufreq policy governor"
	depends on CPU_FREQ
	select CPU_FREQ_GOV_ATTR_SET
	select IRQ_WORK
	help
	  This governor makes decisions based on the utilization data provided
	  by the scheduler.  It sets the CPU frequency to be proportional to
	  the utilization/capacity ratio coming from the scheduler.  If the
	  utilization is frequency-invariant, the new frequency is also
	  proportional to the maximum available frequency.  If that is not the
	  case, it is proportional to the current frequency of the CPU.  The
	  frequency tipping point is at utilization/capacity equal to 80% in
	  both cases.

	  To compile this driver as a module, choose M here: the module will
	  be called cpufreq_blu_schedutil.

	  If in doubt, say N.

config CPU_FREQ_GOV_PWRUTILX
	bool "'pwrutilx' cpufreq policy governor"
	depends on CPU_FREQ && SMP
	select CPU_FREQ_GOV_ATTR_SET
	select IRQ_WORK
	help
	  This governor makes decisions based on the utilization data provided
	  by the scheduler.  It sets the CPU frequency to be proportional to
	  the utilization/capacity ratio coming from the scheduler.  If the
	  utilization is frequency-invariant, the new frequency is also
	  proportional to the maximum available frequency.  If that is not the
	  case, it is proportional to the current frequency of the CPU.

	  If in doubt, say N.

config CPU_FREQ_GOV_SCHEDALUCARD
	bool "'schedalucard' cpufreq policy governor"
	depends on CPU_FREQ && SMP
	select CPU_FREQ_GOV_ATTR_SET
	select IRQ_WORK
	help
	  This governor makes decisions based on the utilization data provided
	  by the scheduler.  It sets the CPU frequency to be proportional to
	  the utilization/capacity ratio coming from the scheduler. The
	  frequency tipping point is at utilization/capacity equal to 80%
	  by default.

	  If in doubt, say N.

config CPU_INPUT_BOOST
	bool "CPU Input Boost"
	help
	  Boosts the CPU on touchscreen and touchpad input, and allows for
	  boosting on other custom events, mainly which is intended to be for
	  boosting when there is a new frame ready to be rendered to the
	  display. The boost frequencies for this driver should be set so that
	  frame drops are near-zero at the boosted frequencies and power
	  consumption is minimized at said frequency combination.

if CPU_INPUT_BOOST

config INPUT_BOOST_DURATION_MS
	int "Input boost duration"
	default "100"
	help
	  Input boost duration in milliseconds.

config WAKE_BOOST_DURATION_MS
	int "Wake boost duration"
	default "1000"
	help
	  Wake boost duration in milliseconds.

config INPUT_BOOST_FREQ_LP
	int "Low-power cluster boost freq"
	default "0"
	help
	  Input boost frequency for the low-power CPU cluster.

config INPUT_BOOST_FREQ_PERF
	int "Performance cluster boost freq"
	default "0"
	help
	  Input boost frequency for the performance CPU cluster.

endif

comment "CPU frequency scaling drivers"

config DSBOOST
	tristate "Dynamic SchedTune Boosting on events"
	depends on DYNAMIC_STUNE_BOOST
	help
	  This driver attempts to improve responsiveness on mobile devices
	  with Dynamic SchedTune Boosting support. Boosts are applied on
	  user input, after user input unboosts, and on a sched_boost trigger.

	  If in doubt, say N.

if DSBOOST

config INPUT_BOOST_DURATION
	int "Input boost duration"
	default "64"
	help
	  Default duration to boost on input.

config INPUT_STUNE_BOOST
	int "Input SchedTune boost level"
	default "15"
	help
	  Default SchedTune boost level for the top-app cgroup.

	  A value of 0 disables SchedTune boosting for this level.

config SCHED_STUNE_BOOST
	int "Sched SchedTune boost level"
	default "12"
	help
	  Default SchedTune boost level for the top-app cgroup for
	  sched_boost calls.

	  A value of 0 disables SchedTune boosting for this level.

endif

config CPUFREQ_DT
	tristate "Generic DT based cpufreq driver"
	depends on HAVE_CLK && OF
	# if CPU_THERMAL is on and THERMAL=m, CPUFREQ_DT cannot be =y:
	depends on !CPU_THERMAL || THERMAL
	select PM_OPP
	help
	  This adds a generic DT based cpufreq driver for frequency management.
	  It supports both uniprocessor (UP) and symmetric multiprocessor (SMP)
	  systems which share clock and voltage across all CPUs.

	  If in doubt, say N.

if X86
source "drivers/cpufreq/Kconfig.x86"
endif

if ARM || ARM64
source "drivers/cpufreq/Kconfig.arm"
endif

if PPC32 || PPC64
source "drivers/cpufreq/Kconfig.powerpc"
endif

if AVR32
config AVR32_AT32AP_CPUFREQ
	bool "CPU frequency driver for AT32AP"
	depends on PLATFORM_AT32AP
	default n
	help
	  This enables the CPU frequency driver for AT32AP processors.
	  If in doubt, say N.
endif

if IA64
config IA64_ACPI_CPUFREQ
	tristate "ACPI Processor P-States driver"
	depends on ACPI_PROCESSOR
	help
	This driver adds a CPUFreq driver which utilizes the ACPI
	Processor Performance States.

	For details, take a look at <file:Documentation/cpu-freq/>.

	If in doubt, say N.
endif

if MIPS
config LOONGSON2_CPUFREQ
	tristate "Loongson2 CPUFreq Driver"
	depends on LEMOTE_MACH2F
	help
	  This option adds a CPUFreq driver for loongson processors which
	  support software configurable cpu frequency.

	  Loongson2F and it's successors support this feature.

	  For details, take a look at <file:Documentation/cpu-freq/>.

	  If in doubt, say N.

config LOONGSON1_CPUFREQ
	tristate "Loongson1 CPUFreq Driver"
	depends on LOONGSON1_LS1B
	help
	  This option adds a CPUFreq driver for loongson1 processors which
	  support software configurable cpu frequency.

	  For details, take a look at <file:Documentation/cpu-freq/>.

	  If in doubt, say N.
endif

if SPARC64
config SPARC_US3_CPUFREQ
	tristate "UltraSPARC-III CPU Frequency driver"
	help
	  This adds the CPUFreq driver for UltraSPARC-III processors.

	  For details, take a look at <file:Documentation/cpu-freq>.

	  If in doubt, say N.

config SPARC_US2E_CPUFREQ
	tristate "UltraSPARC-IIe CPU Frequency driver"
	help
	  This adds the CPUFreq driver for UltraSPARC-IIe processors.

	  For details, take a look at <file:Documentation/cpu-freq>.

	  If in doubt, say N.
endif

if SUPERH
config SH_CPU_FREQ
	tristate "SuperH CPU Frequency driver"
	help
	  This adds the cpufreq driver for SuperH. Any CPU that supports
	  clock rate rounding through the clock framework can use this
	  driver. While it will make the kernel slightly larger, this is
	  harmless for CPUs that don't support rate rounding. The driver
	  will also generate a notice in the boot log before disabling
	  itself if the CPU in question is not capable of rate rounding.

	  For details, take a look at <file:Documentation/cpu-freq>.

	  If unsure, say N.
endif

config QORIQ_CPUFREQ
	tristate "CPU frequency scaling driver for Freescale QorIQ SoCs"
	depends on OF && COMMON_CLK && (PPC_E500MC || ARM)
	select CLK_QORIQ
	help
	  This adds the CPUFreq driver support for Freescale QorIQ SoCs
	  which are capable of changing the CPU's frequency dynamically.

endif
endmenu
```

## drivers/input/fingerprint/Kconfig
```kconfig
#
# Fingerprint driver configuration
#

menu "Fingerprint Drivers"

config FINGERPRINT_FPC1020
	tristate "fpc1020 fingerprint driver support"
	help
	  Say Y here to enable fpc1020 fingerprint driver support!

	  If unsure, say N.

	  To compile this driver as a module, choose M here.

config FINGERPRINT_GOODIX
	tristate "goodix fingerprint driver support"
	help
	  Say Y here to enable goodix fingerprint driver support!  

	  If unsure, say N.

	  To compile this driver as a module, choose M here.

source "drivers/input/fingerprint/fpc/Kconfig"

source "drivers/input/fingerprint/goodix/Kconfig"

endmenu
```

## drivers/input/fingerprint/fpc/Kconfig
```kconfig
#
# Fpc1020 fingerprint driver configuration
#

config FINGERPRINT_FPC1020
	tristate "fpc1020 fingerprint drvier support"
	default n
	help
	  Say Y here to enable fpc1020 fingerprint driver support!

	  If unsure, say N.

	  To compile this driver as a module, choose M here.
```

## drivers/input/fingerprint/goodix/Kconfig
```kconfig
#
# Goodix fingerprint driver configuration
#

config FINGERPRINT_GOODIX
	tristate "goodix fingerprint drvier support"
	default n
	help
	  Say Y here to enable goodix fingerprint driver support!

	  If unsure, say N.

	  To compile this driver as a module, choose M here.
```

## drivers/platform/Kconfig
```kconfig
if X86
source "drivers/platform/x86/Kconfig"
endif
if MIPS
source "drivers/platform/mips/Kconfig"
endif
if ARCH_QCOM
source "drivers/platform/xiaomi/Kconfig"
endif
source "drivers/platform/goldfish/Kconfig"

source "drivers/platform/chrome/Kconfig"

source "drivers/platform/msm/Kconfig"
```

## drivers/platform/xiaomi/Kconfig
```kconfig
menu "Xiaomi board selection"

config KERNEL_XIAOMI_A26X
	bool "Custom for a26x board"
	depends on ARCH_QCOM
	default n
	help
	  Say Y to enable support for Xiaomi MIA2 & MI6X.

	  If in doubt, say N.

config KERNEL_XIAOMI_LAVENDER
	bool "Custom for lavender board"
	depends on ARCH_QCOM
	default n
	help
	  Say Y to enable support for Xiaomi Redmi Note 7.

	  If in doubt, say N.

config KERNEL_XIAOMI_TULIP
	bool "Custom for tulip board"
	depends on ARCH_QCOM
	default n
	help
	  Say Y to enable support for Xiaomi Redmi Note 6 Pro

	  If in doubt, say N.

config KERNEL_XIAOMI_WHYRED
	bool "Custom for whyred board"
	depends on ARCH_QCOM
	default n
	help
	  Say Y to enable support for Xiaomi Redmi Note 5 Pro / AI

	  If in doubt, say N.

endmenu
```
