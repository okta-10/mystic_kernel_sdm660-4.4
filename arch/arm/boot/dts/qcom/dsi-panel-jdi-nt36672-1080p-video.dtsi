/* Copyright (c) 2017, The Linux Foundation. All rights reserved.
 * Copyright (C) 2019 XiaoMi, Inc.
 *
 * This program is free software; you can redistribute it and/or modify
 * it under the terms of the GNU General Public License version 2 and
 * only version 2 as published by the Free Software Foundation.
 *
 * This program is distributed in the hope that it will be useful,
 * but WITHOUT ANY WARRANTY; without even the implied warranty of
 * MERCHANTABILITY or FITNESS FOR A PARTICULAR PURPOSE.  See the
 * GNU General Public License for more details.
 */

&mdss_mdp {
	dsi_nt36672_jdi_fhd_video: qcom,mdss_dsi_nt36672_jdi_fhd_video {
		qcom,mdss-dsi-panel-name = "jdi nt36672 fhd video mode dsi panel";
		qcom,mdss-dsi-panel-controller = <&mdss_dsi0>;
		qcom,mdss-dsi-panel-type = "dsi_video_mode";
		qcom,mdss-dsi-panel-framerate = <60>;
		qcom,mdss-dsi-virtual-channel-id = <0>;
		qcom,mdss-dsi-stream = <0>;
		qcom,mdss-dsi-panel-width = <1080>;
		qcom,mdss-dsi-panel-height = <2160>;
		qcom,mdss-pan-physical-width-dimension = <68>;
		qcom,mdss-pan-physical-height-dimension = <136>;
		qcom,mdss-dsi-h-front-porch = <96>;
		qcom,mdss-dsi-h-back-porch = <56>;
		qcom,mdss-dsi-h-pulse-width = <4>;
		qcom,mdss-dsi-h-sync-skew = <0>;
		qcom,mdss-dsi-v-back-porch = <33>;
		qcom,mdss-dsi-v-front-porch = <4>;
		qcom,mdss-dsi-v-pulse-width = <2>;
		qcom,mdss-dsi-h-left-border = <0>;
		qcom,mdss-dsi-h-right-border = <0>;
		qcom,mdss-dsi-v-top-border = <0>;
		qcom,mdss-dsi-v-bottom-border = <0>;
		qcom,mdss-dsi-bpp = <24>;
		qcom,mdss-dsi-underflow-color = <0xff>;
		qcom,mdss-dsi-border-color = <0>;
		qcom,mdss-dsi-h-sync-pulse = <0>;
		qcom,mdss-dsi-traffic-mode = "burst_mode";
		qcom,mdss-dsi-bllp-eof-power-mode;
		qcom,mdss-dsi-bllp-power-mode;
		qcom,mdss-dsi-lane-0-state;
		qcom,mdss-dsi-lane-1-state;
		qcom,mdss-dsi-lane-2-state;
		qcom,mdss-dsi-lane-3-state;
		qcom,mdss-dsi-panel-timings = [e6 38 26 00 68 6e 2a
				3c 44 03 04 00];
		qcom,mdss-dsi-t-clk-post = <0x0d>;
		qcom,mdss-dsi-t-clk-pre = <0x32>;
		qcom,mdss-dsi-bl-min-level = <1>;
		qcom,mdss-dsi-bl-max-level = <4095>;
		qcom,mdss-brightness-max-level = <4095>;
		qcom,mdss-dsi-dma-trigger = "trigger_sw";
		qcom,mdss-dsi-mdp-trigger = "none";
        qcom,mdss-dsi-on-command = [
            15 01 00 00 00 00 02 ff 20
            15 01 00 00 00 00 02 fb 01
            15 01 00 00 00 00 02 30 10
            15 01 00 00 00 00 02 31 50
            15 01 00 00 00 00 02 32 2f
            15 01 00 00 00 00 02 ff 10
            05 01 00 00 46 00 02 11 00
            15 01 00 00 00 00 02 51 ff
            39 01 00 00 00 00 03 68 03 04
            15 01 00 00 00 00 02 53 2c
            15 01 00 00 00 00 02 55 00
            05 01 00 00 14 00 02 29 00
        ];
        qcom,mdss-dsi-off-command = [
            05 01 00 00 14 00 02 28 00
            05 01 00 00 78 00 02 10 00
        ];
		qcom,mdss-dsi-ce-on-command = [
				29 01 00 00 00 00 2C CA 1D FC FC FC 00 C1 D3 37 00 3D 0E 13 00 1D FF 00 19 11 00 00 00 3F D5 A1 89 D8 9E 87 40 00 00 00 00 00 00 00 00 00 00 00 00 00 00
		];
		qcom,mdss-dsi-ce-off-command = [
				29 01 00 00 00 00 2C CA 1C FC FC FC 00 C1 D3 37 00 3D 0E 13 00 1D FF 00 19 11 00 00 00 3F D5 A1 89 D8 9E 87 40 00 00 00 00 00 00 00 00 00 00 00 00 00 00
		];
		qcom,mdss-dsi-srgb-on-command = [
				29 01 00 00 00 00 2C CA 1D FC FC BC 1F 09 F1 D9 05 D5 EF DC DD 03 F7 E2 F8 05 E9 01 00 2C FF 00 00 FF 00 22 FF 00 FF 00 45 FD 45 FF 00 00 FF 01 2D F6 FF
		];
		qcom,mdss-dsi-srgb-off-command = [
				29 01 00 00 00 00 2C CA 1D FC FC FC 61 FD D4 FA 7F E6 D9 D0 F3 BC A8 94 1D 0E F8 E0 E0 16 FF 00 00 E4 01 23 FF 00 FF 00 50 E3 43 FF 00 00 FF 01 32 E0 FF
		];
		qcom,mdss-dsi-cabc-on-command = [
            15 01 00 00 00 00 02 FF 23
            15 00 00 00 00 00 02 07 20
            15 00 00 00 00 00 02 08 05
            15 00 00 00 00 00 02 09 00
            15 00 00 00 00 00 02 10 95
            15 00 00 00 00 00 02 30 FF
            15 00 00 00 00 00 02 31 FF
            15 00 00 00 00 00 02 32 FF
            15 00 00 00 00 00 02 33 FF
            15 00 00 00 00 00 02 34 FF
            15 01 00 00 00 00 02 35 FF
            15 00 00 00 00 00 02 36 FF
            15 00 00 00 00 00 02 37 FF
            15 00 00 00 00 00 02 38 FF
            15 00 00 00 00 00 02 39 FF
            15 00 00 00 00 00 02 3A FF
            15 00 00 00 00 00 02 3B F9
            15 00 00 00 00 00 02 3D D9
            15 00 00 00 00 00 02 3F B9
            15 00 00 00 00 00 02 40 AB
            15 00 00 00 00 00 02 41 98
            15 01 00 00 00 00 02 FF 10
            15 01 00 00 00 00 02 55 01
		];
		qcom,mdss-dsi-cabc-off-command = [
            15 01 00 00 00 00 02 FF 10
			15 01 00 00 00 00 02 55 00
		];
		qcom,mdss-dsi-gamma0-command = [
		];
		qcom,mdss-dsi-gamma1-command = [
		];
		qcom,mdss-dsi-gamma2-command = [
		];
		qcom,mdss-dsi-gamma3-command = [
		];
		qcom,mdss-dsi-gamma4-command = [
		];
		qcom,mdss-dsi-gamma5-command = [
		];
		qcom,mdss-dsi-gamma6-command = [
		];
		qcom,mdss-dsi-gamma7-command = [
		];
		qcom,mdss-dsi-gamma8-command = [
		];
		qcom,mdss-dsi-gamma9-command = [
		];
		qcom,mdss-dsi-gamma10-command = [
		];
		qcom,mdss-dsi-gamma11-command = [
		];
		qcom,mdss-dsi-gamma12-command = [
		];
		qcom,mdss-dsi-gamma13-command = [
		];
		qcom,mdss-dsi-gamma14-command = [
		];
		qcom,mdss-dsi-gamma15-command = [
		];
		qcom,mdss-dsi-gamma16-command = [
		];
		qcom,mdss-dsi-gamma17-command = [
		];
		qcom,mdss-dsi-gamma18-command = [
		];
		qcom,mdss-dsi-gamma19-command = [
		];
		qcom,mdss-dsi-gamma20-command = [
		];
		qcom,mdss-dsi-gamma21-command = [
		];
		qcom,mdss-dsi-gamma22-command = [
		];
		qcom,mdss-dsi-gamma23-command = [
		];
		qcom,mdss-dsi-gamma24-command = [
		];
		qcom,mdss-dsi-on-command-state = "dsi_lp_mode";
		qcom,mdss-dsi-off-command-state = "dsi_hs_mode";
		qcom,mdss-dsi-ce-on-command-state = "dsi_hs_mode";
		qcom,mdss-dsi-ce-off-command-state = "dsi_hs_mode";
		qcom,mdss-dsi-srgb-on-command-state = "dsi_hs_mode";
		qcom,mdss-dsi-srgb-off-command-state = "dsi_hs_mode";
		qcom,mdss-dsi-cabc-on-command-state = "dsi_hs_mode";
		qcom,mdss-dsi-cabc-off-command-state = "dsi_hs_mode";
		qcom,mdss-dsi-gamma-command-state = "dsi_hs_mode";
		qcom,mdss-dsi-bl-pmic-control-type = "bl_ctrl_wled";
		qcom,mdss-dsi-reset-sequence = <1 1>, <0 5>, <1 15>;
		qcom,mdss-dsi-tx-eot-append;
		qcom,mdss-dsi-post-init-delay = <1>;
		
		qcom,esd-check-enabled;
		qcom,mdss-dsi-panel-status-command = [06 01 00 01 05 00 01 0A];
		qcom,mdss-dsi-panel-status-command-state = "dsi_hs_mode";
		qcom,mdss-dsi-panel-status-check-mode = "reg_read";
		qcom,mdss-dsi-panel-status-read-length = <1>;
		qcom,mdss-dsi-panel-status-value = <0x9c>;
		qcom,mdss-dsi-panel-max-error-count = <3>;

		qcom,mdss-dsi-pan-enable-dynamic-bitclk;
		qcom,mdss-dsi-dynamic-bitclk_freq = <798240576 801594528 804948480
		808302432 811656384>;
		qcom,ulps-enabled;
		qcom,mdss-dsi-panel-hdr-enabled;
		qcom,mdss-dsi-panel-hdr-color-primaries = <14500 15500 32000
			17000 15500 30000 8000 3000>;
		qcom,mdss-dsi-panel-peak-brightness = <4200000>;
		qcom,mdss-dsi-panel-blackness-level = <3230>;
		qcom,partial-update-enabled = "single_roi";
		qcom,panel-roi-alignment = <540 270 270 270 1080 270>;
		qcom,mdss-dsi-te-pin-select = <1>;
		qcom,mdss-dsi-te-dcs-command = <1>;
		qcom,mdss-dsi-te-check-enable;
		qcom,mdss-dsi-te-using-te-pin;
		qcom,mdss-tear-check-sync-init-val = <2160>;
		qcom,mdss-tear-check-start-pos = <2160>;
		qcom,mdss-tear-check-rd-ptr-trigger-intr = <2161>;
		
	};
};
